
const unsigned char techtopia[] PROGMEM = {
  0x00, 0x00, 0x00, 0x00, 0x00, 0x00, 0x00, 0x00, 0x7c, 0x00, 0x00, 0x00, 0x00, 0x00, 0x00, 0x00, 
  0x00, 0x00, 0x00, 0x00, 0x00, 0x00, 0x00, 0x01, 0xff, 0x00, 0x00, 0x00, 0x00, 0x00, 0x00, 0x00, 
  0x00, 0x00, 0x00, 0x00, 0x00, 0x00, 0x00, 0x03, 0xff, 0x80, 0x00, 0x00, 0x00, 0x00, 0x00, 0x00, 
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  0x00, 0x00, 0x00, 0x00, 0x00, 0x00, 0x00, 0x00, 0x00, 0x00, 0x00, 0x00, 0x00, 0x00, 0x00, 0x00
};


void text(String t, byte x, byte y) {
  display.setCursor(x, y);
  display.print(t);
}

void pinik() {
  display.clearDisplay();
  display.drawBitmap(0, 0, techtopia, 128, 64, 1);
  display.display();
}

void analog_reading_display() {
  byte i = 0;
  display.clearDisplay();
  for (i = 0; i < 6; i++)  s[i] = analogRead(i + 8);
  for (i = 0; i < 3 ; i++) {
    value = String(s[i], 10);
    text(value, 72, 46 - (i * 22));
  }
  for (i = 3; i < 6; i++) {
    value = String(s[i], 10);
    text(value, 12,  (i * 22) - 64);
  }
  display.display();
}

void digital_reading_display() {
  display.clearDisplay();
  check();
  for (short int i = 5; i >= 0; i--) {
    value = String(s[i], 2);
    text(value, 115 - (i * 23), 0);
  }
  value = String(sum, 10); text("sum = " + value, 0, 25);
  value = String(bin, 10); text("bin = " + value, 0, 50);
  display.display();
}

void text_line_follow() {
  display.clearDisplay();
  text("LineFollow", 4, 12);
  text("C", 0, 38);
  text(":", 10, 38);
  value = String(counter, 10); text(value, 20, 38);
  text("S", 55, 38); text(":", 65, 38);
  value = String(sp, 10); text(value, 75, 38);
  side = EEPROM.read(9) / 100;
  if (side == 0) text("S", 116, 38);
  else if (side == 1) text("R", 116, 38);
  else if (side == 2) text("L", 116, 38);
  display.display();
}

void text_maze_follow() {
  display.clearDisplay();
  text("   MAZE   ", 4, 0);
  text(" FUNCTION ", 4, 25);
  text("C", 0, 50); text(":", 10, 50);
  value = String(counter, 10); text(value, 20, 50);
  text("S", 55, 50); text(":", 65, 50);
  value = String(sp, 10); text(value, 75, 50);
  side = EEPROM.read(9) / 100;
  if (side == 0) text("S", 116, 50);
  else if (side == 1) text("R", 116, 50);
  else if (side == 2) text("L", 116, 50);
  display.display();
}

void text_speed_adjust() {
  display.clearDisplay();
  text("SPEED", 35, 0);
  text("ADJUST", 29, 25);
  text("S:    E:  ", 0, 50);
  short int p = sp * 10;
  value = String(p, 10); text(value, 23, 50);
  p = spe;
  value = String(p, 10); text(value, 92, 50);
  display.display();
}

void sonar_reading_display() {
  sonar();
  display.clearDisplay();
  text("L   F   R", 10, 12);
  value = String(sl, 10); text(value, 5, 38);
  value = String(sf, 10); text(value, 52, 38);
  value = String(sr, 10); text(value, 99, 38);
  display.display();
}

void serial_reading_display() {
  int i = 0;
  display.clearDisplay();
  display.display();
  display.setTextSize(1);
  display.setCursor(2, 0);
  display.invertDisplay(1);
  while (digitalRead(mb) == HIGH) {
    if (Serial.available() > 0) {
      if (i == 8) {
        display.clearDisplay();
        i = 0;
        display.setCursor(2, 0);
      }
      display.write(Serial.read());
      if (Serial.available() == 0) {
        i++;
        display.display();
        display.setCursor(2, i * 8);
      }
    }
  }
  display.clearDisplay();
  display.display();
  display.setTextSize(2);
  display.invertDisplay(false);
}

void text_callibrating() {
  byte i;
  display.clearDisplay();
  text(" STARTING ", 04, 18);
  display.display();
  for (i = 0; i < 120; i += 8) {
    if (digitalRead(mb) == LOW) break;
    text(".", i + 2, 32);
    display.display();
  }
  while (digitalRead(mb) == LOW);
  if (i >= 120) cal();
  else
    for (byte i = 0; i < 6; i++) {
      maximum[i] = EEPROM.read(i + 38) * 5;
      minimum[i] = EEPROM.read(i + 44) * 5;
    }
  //for showing the thresould value
  display.clearDisplay();
  display.setTextSize(1);
  for (byte i = 0; i < 6 ; i++) {
    value = String(minimum[i], 10);
    if (i >= 0 && i <= 2) text(value,  32 + (i * 32), 0);
    if (i >= 3 && i <= 5) text(value, (i * 32) - 64, 10);
  }
  for (byte i = 0; i < 6 ; i++) {
    value = String(trash[i], 10);
    if (i >= 0 && i <= 2) text(value,  32 + (i * 32), 23);
    if (i >= 3 && i <= 5) text(value, (i * 32) - 64, 33);
  }
  for (byte i = 0; i < 6 ; i++) {
    value = String(maximum[i], 10);
    if (i >= 0 && i <= 2) text(value,  32 + (i * 32), 46);
    if (i >= 3 && i <= 5) text(value, (i * 32) - 64, 56);
  }
  text("MIN", 8, 5); text("MID", 8, 28); text("MAX", 8, 51);
  display.drawLine(0, 20, 128, 20, WHITE);
  display.drawLine(0, 43, 128, 43, WHITE);
  display.display();
  display.setTextSize(2);
  for (byte i = 0; i < 6; i++) {
    maximum[i] = 0; minimum[i] = 1024;
  }
  while (digitalRead(mb) == HIGH);
  while (digitalRead(mb) == LOW);
}
